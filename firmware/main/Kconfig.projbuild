## firmware/main/Kconfig.projbuild
```kconfig
menu "BuddyAI"

    config BUDDYAI_RELEASE_BUILD
        bool "Release (production) build"
        default n
        help
            Set by sdkconfig.release. Hardens the firmware for customer units:
            the setup portal has no Server URL field, the watch connects only
            to BUDDYAI_DEFAULT_SERVER_URL (wss://), and OTA URLs must be
            https://.
            Development builds (default) keep plain ws:// / http:// for a LAN
            server.

    config BUDDYAI_DEFAULT_SERVER_URL
        string "Default server URL"
        default ""
        help
            Development builds: WebSocket URL used when no server_url was
            configured through the SoftAP portal, e.g.
            ws://192.168.1.10:8765/ws/device (empty: last-known server or mDNS).
            Release builds: the only server the watch connects to (set in
            sdkconfig.release, must be wss://).

    config BUDDYAI_HW_MODEL
        string "Hardware model string sent in hello"
        default "waveshare-esp32-s3-touch-amoled-2.06"

    config BUDDYAI_MDNS_DISCOVERY
        bool "Enable mDNS _buddyai._tcp discovery"
        default y
        help
            Optional convenience discovery for LAN development. The firmware
            works fully without it.

    config BUDDYAI_LOW_BATTERY_PCT
        int "Low battery warning threshold (%)"
        range 1 30
        default 5

    config BUDDYAI_PM_MIN_FREQ_MHZ
        int "CPU frequency in standby (MHz)"
        depends on PM_ENABLE
        range 40 240
        default 80
        help
            While the screen is in standby the CPU runs at this frequency;
            awake (and during every conversation) it runs at full speed.
            80 MHz keeps the Wi-Fi/TLS link comfortable.

    config BUDDYAI_PM_LIGHT_SLEEP
        bool "Automatic light sleep in standby"
        depends on PM_ENABLE && FREERTOS_USE_TICKLESS_IDLE
        default y
        help
            While the screen is off, the chip sleeps between Wi-Fi beacons
            (esp_pm automatic light sleep). The Wi-Fi association and the
            server connection stay up; a touch, the BOOT key, the PWR key
            (polled every second) or a message from the server wakes it.
            Off: the CPU only drops to CONFIG_BUDDYAI_PM_MIN_FREQ_MHZ.

    config BUDDYAI_STANDBY_LISTEN_INTERVAL
        int "Wi-Fi beacons between radio wake-ups in standby (0 = every DTIM)"
        range 0 10
        default 3
        help
            While the screen is off the radio uses WIFI_PS_MAX_MODEM and
            wakes every this many beacons (about 100 ms each): server
            messages arrive up to that much later. 0 keeps
            WIFI_PS_MIN_MODEM (every DTIM beacon), for access points or
            phone hotspots that drop sleeping clients.

endmenu
```
